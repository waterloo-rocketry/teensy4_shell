## Kconfig
```
# Copyright (c) 2019 Nordic Semiconductor ASA
# SPDX-License-Identifier: Apache-2.0

config USB_DEVICE_PID
	default 0x1234

config LOG_BACKEND_UART
    bool "Enable UART backend"
    default y if !SHELL_BACKEND_SERIAL
    depends on UART_CONSOLE && !LOG_MINIMAL && LOG
    help
      When enabled backend is using UART to output logs.

source "Kconfig.zephyr"
```

## prj.conf
```kconfig
# enable logging and GPIO
CONFIG_LOG=y
CONFIG_GPIO=y

# Set following configs for USB and UART
# CONFIG_USB=y
CONFIG_USB_DEVICE_STACK=y
# CONFIG_USB_UART_CONSOLE=y
CONFIG_USB_DEVICE_PRODUCT="Zephyr first steps"
CONFIG_USB_DRIVER_LOG_LEVEL_ERR=y
CONFIG_UART_INTERRUPT_DRIVEN=y
CONFIG_UART_LINE_CTRL=y

# Floating Point Options
CONFIG_FPU=y
CONFIG_FPU_SHARING=y

# enable POSIX date and time api
CONFIG_POSIX_CLOCK=y

# enable the function sys_reboot()
CONFIG_REBOOT=y

# For using the shell
CONFIG_SHELL_PROMPT_UART="teensy:~$ "
CONFIG_PRINTK=y
CONFIG_SHELL=y
CONFIG_SHELL_BACKEND_SERIAL=y
# CONFIG_UART_SHELL_ON_DEV_NAME="UART_6"
CONFIG_SHELL_LOG_BACKEND=y
# CONFIG_OBJECT_TRACING=y
CONFIG_THREAD_MONITOR=y
CONFIG_INIT_STACKS=y
CONFIG_BOOT_BANNER=n
CONFIG_THREAD_NAME=y
CONFIG_SHELL_HISTORY=y
CONFIG_SHELL_STACK_SIZE=2048
CONFIG_SHELL_CMD_BUFF_SIZE=128
CONFIG_SHELL_WILDCARD=y
# CONFIG_SHELL_DYNAMIC_CMDS=n
CONFIG_SHELL_VT100_COLORS=y
CONFIG_SHELL_HELP_ON_WRONG_ARGUMENT_COUNT=y
CONFIG_SHELL_STATS=y
CONFIG_SHELL_CMDS=y
CONFIG_SHELL_HELP=y
CONFIG_SHELL_TAB=y
CONFIG_SHELL_METAKEYS=y
CONFIG_SHELL_LOG_BACKEND=y
CONFIG_KERNEL_SHELL=y
CONFIG_DEVICE_SHELL=y
CONFIG_DATE_SHELL=y
CONFIG_CBPRINTF_NANO=y
CONFIG_SENSOR_SHELL=n
CONFIG_SHELL_CMDS_SELECT=y
```

## src/led.c
```c
/**
 * @file led.c
 * @author Bernhard Kraemer, Uwe Fechner
 * @brief Toggle board led periodically.
 * @version 0.2
 * @date 2021-01-02
 * 
 * @copyright Copyright (c) 2020
 * 
 */

/*** Imported Objects ***************************************************************/
#include <zephyr/kernel.h>
#include <zephyr/logging/log.h>

#include <zephyr/drivers/gpio.h>

#include "globals.h"

/*** Constants **********************************************************************/
#define LOG_MODULE_NAME led

#define START_DELAY     500
#define STACK_SIZE      500
#define PRIORITY        5

#define TOGGLE_TIME_MS  1000

/* The devicetree node identifier for the "led0" alias. */
#define LED0_NODE DT_ALIAS(led0)
#define LED0_GPIO_LABEL DT_GPIO_LABEL(LED0_NODE, gpios)
#define LED0_GPIO_PIN DT_GPIO_PIN(LED0_NODE, gpios)
#define LED0_GPIO_FLAGS DT_GPIO_FLAGS(LED0_NODE, gpios)

/*** Function Prototypes ************************************************************/
void led_main_f();

/*** Macros *************************************************************************/
LOG_MODULE_REGISTER(LOG_MODULE_NAME, LOG_LEVEL_INF);

K_THREAD_DEFINE(led_id, STACK_SIZE, led_main_f, NULL, NULL, NULL,
                PRIORITY, 0, START_DELAY);

/*** Function implementation ********************************************************/

void led_main_f()
{
    bool led_is_on = true;
    const struct device *dev;

    dev = device_get_binding(LED0_GPIO_LABEL);
    if (dev == NULL) {
        LOG_ERR("Device binding is NULL");
        return;
    }

    if (gpio_pin_configure(dev, LED0_GPIO_PIN, GPIO_OUTPUT_ACTIVE | LED0_GPIO_FLAGS)) {
        LOG_ERR("GPIO configuration failed");
        return;
    }

    LOG_INF("Thread started");

    while (true) {
        gpio_pin_set(dev, LED0_GPIO_PIN, (int)led_is_on);

        LOG_DBG("LED state changed: %u", (int)led_is_on);

        if (blink_stat) {
            led_is_on = !led_is_on;
        } else {
            led_is_on = false;
        }

        /* make sure that the LED immediately turns on when the command
           "blink on" is executed */
        if (k_msleep(TOGGLE_TIME_MS)) {
            if (blink_stat) {
                led_is_on = true;
            }
        };
    }
}
```
